## board/charge/mx6ul_charge/Kconfig
```kconfig
if TARGET_MX6UL_CHARGE

config SYS_BOARD
	default "mx6ul_charge"

config SYS_VENDOR
	default "charge"

config SYS_CONFIG_NAME
	default "mx6ul_charge"

endif
```
